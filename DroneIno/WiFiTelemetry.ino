/*
  WiFiTelemetry
  @author @sebastiano123-c
*/

void notFound(AsyncWebServerRequest *request) {
  request->send(404, "text/plain", "Not found");
}


String processor(const String& var){
  /* 
  * @brief substittue the HTML tag with the variable
  */
  
  if (var == "PITCHANGLE")      return String(anglePitch);
  else if( var == "ROLLANGLE")  return String(angleRoll);
  else if( var == "FLIGHTMODE") return String(flightMode);
  else if( var == "BATTERY")    return String(batteryPercent);
}

void setupWiFiTelemetry(){
  /* 
  * @brief setup the wifi server AP (generated by the ESP)
  * @link 192.168.4.1 @endlink 
  */

  WiFi.softAP(ssid, password);

  // Serial.printf("\nIP address: " + WiFi.softAPIP() + "\n");
  
  server.on("/", HTTP_GET, [](AsyncWebServerRequest *request){
    request->send_P(200, "text/html", index_html, processor);
  });
  
// Send a GET request to <ESP_IP>/get?input1=<inputMessage>
  server.on("/get", HTTP_GET, [] (AsyncWebServerRequest *request) {
    String inputMessage;
    String inputParam;
    const char* textStefi;
    float inputValue;
    // GET input1 value on <ESP_IP>/get?input1=<inputMessage>
    if (request->hasParam(P_ROLL_GET)) {
      inputMessage = request->getParam(P_ROLL_GET)->value();
      inputParam = P_ROLL_GET;
      PID_P_GAIN_ROLL = inputMessage.toFloat();
    }
    // GET input2 value on <ESP_IP>/get?input2=<inputMessage>
    else if (request->hasParam(I_ROLL_GET)) {
      inputMessage = request->getParam(I_ROLL_GET)->value();
      inputParam = I_ROLL_GET;
      PID_I_GAIN_ROLL = inputMessage.toFloat();
    }
    // GET input3 value on <ESP_IP>/get?input3=<inputMessage>
    else if (request->hasParam(D_ROLL_GET)) {
      inputMessage = request->getParam(D_ROLL_GET)->value();
      inputParam = D_ROLL_GET;
      PID_D_GAIN_ROLL = inputMessage.toFloat();
    }
    // picth
    else if (request->hasParam(P_PITCH_GET)) {
      inputMessage = request->getParam(P_PITCH_GET)->value();
      inputParam = P_PITCH_GET;
      PID_P_GAIN_PITCH = inputMessage.toFloat();
    }
    else if (request->hasParam(I_PITCH_GET)) {
      inputMessage = request->getParam(I_PITCH_GET)->value();
      inputParam = I_PITCH_GET;
      PID_I_GAIN_PITCH = inputMessage.toFloat();
    }
    else if (request->hasParam(D_PITCH_GET)) {
      inputMessage = request->getParam(D_PITCH_GET)->value();
      inputParam = D_PITCH_GET;
      PID_D_GAIN_PITCH = inputMessage.toFloat();
    }
    // yaw
    else if (request->hasParam(P_YAW_GET)) {
      inputMessage = request->getParam(P_YAW_GET)->value();
      inputParam = P_YAW_GET;
      PID_P_GAIN_YAW = inputMessage.toFloat();
    }
    else if (request->hasParam(I_YAW_GET)) {
      inputMessage = request->getParam(I_YAW_GET)->value();
      inputParam = I_YAW_GET;
      PID_I_GAIN_YAW = inputMessage.toFloat();
    }
    else if (request->hasParam(D_YAW_GET)) {
      inputMessage = request->getParam(D_YAW_GET)->value();
      inputParam = D_YAW_GET;
      PID_D_GAIN_YAW = inputMessage.toFloat();
    }
    else {
      inputMessage = "No message sent";
      inputParam = "none";
      textStefi = "";
    }
    request->send_P(200, "text/html", index_html, processor);
  });

  // Handle Web Server Events
  events.onConnect([](AsyncEventSourceClient *client){
    if(client->lastId()){
      Serial.printf("Client reconnected! Last message ID that it got is: %u\n", client->lastId());
    }
    // send event with message "hello!", id current millis and set reconnect delay to 1 second
    client->send("hello!", NULL, millis(), 10000);
  });
  server.addHandler(&events);

  server.onNotFound(notFound);
  server.begin();
}
 
void sendTelemetry(){
    /* 
    * @brief Send Events to the Web Server with the Sensor Readings
    */
    
    switch (refreshCounter){
      
      case refreshRate:
         events.send("ping" ,NULL, millis());
         events.send(String(anglePitch).c_str(), "anglePitch", millis());
         events.send(String(angleRoll).c_str(), "angleRoll", millis());
         events.send(String(flightMode).c_str(), "flightMode", millis());
         events.send(String(batteryPercent).c_str(), "battery", millis());
         refreshCounter = 0;
         break;

      default:
        refreshCounter += 1;

    }
}
